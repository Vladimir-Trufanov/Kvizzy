/** KRUTJAK-ARDUINO-PRO_MINI                               *** timer2_kru.h ***
 * 
 * Модуль таймера управляющей и исполнительной систем паровозика "КРУТЯК" 
 * 
 * v3.3, 19.04.2024                                   Автор:      Труфанов В.Е.
 * Copyright © 2024 tve                               Дата создания: 12.04.2024
**/

#ifndef timer_kru
#define timer_kru
#pragma once            

#include <Arduino.h>

// Определяем счетчик прерываний от таймера и общее их количество до
// события отправки одного из четырех сообщений = чуть быстрее четверти секунды 
unsigned int cntr = 0;                      // счетчик тиков таймера
volatile unsigned int timerToggle = 21000;  // 62499 -> 1 секунда;
volatile bool OneSecondFlag = false;        // истечение 1 сек для запуска трассировок
volatile bool Motor1_Flag = false;          // истечение 1 четверти сек для отправки данных по мотору
volatile bool Vcc2_Flag = false;            // истечение 2 четверти сек для отправки данных по напряжению батареи
volatile byte quatr = 0;                    // счетчик четвертей секунды

// Определяем счетчик и параметры управления тестов мотора
/*
unsigned int cntrMotion = 0;
volatile unsigned int timerMotion = 6000;   // ~ 1 мсек
volatile bool OneMillSecFlag = false;       // истечение 1 мсек для подачи ШИМ на мотор
*/

// ****************************************************************************
// *                 Инициализировать секундное первое прерывание             *
// *                        (по умолчанию с частотой в 1 Гц)                  *
// ****************************************************************************
void IniTimer2()
{
   cli(); // отключили прерывания
   // Инициализируем регистры Timer2
   TCCR2A = 0; 
   TCCR2B = 0;
   TIMSK2 = 0;
   // Включаем прерывание Timer2 по переполнению
   TIMSK2 = (1 << TOIE2);
   // Устанавливаем CS10 бит так, чтобы таймер работал при тактовой частоте:
   TCCR2B |= (1 << CS20);
   sei(); // включили прерывания
}
// ****************************************************************************
// *               Обработать прерывание по переполнению 2 таймера и          *     
// *                      отметить истечение четверти секунды                 *
// ****************************************************************************
SIGNAL(TIMER2_OVF_vect)
{
   // Увеличиваем счетчик прерываний 
   cntr=cntr+1; 
   // Если счетчик дошел до четверти секунды, то выполняем подстройки
   if (cntr>timerToggle)
   {
      // Снова инициализируем счетчик
      cntr=0;
      // Устанавливаем флаг прошествия 1 секунды и четверти секунды.
      // Флаг всегда устанавливаем в true для того, чтобы основной цикл знал,
      // что секунда истекла (основной цикл по своей логике и сбросит флаг в false)
      quatr=quatr+1; 
      // Отмечаем истечение 1 четверти сек для отправки данных по мотору
      if (quatr==1) Motor1_Flag = true; 
      // Отмечаем истечение 2 четверти сек для отправки данных по напряжению батареи
      if (quatr==2) Vcc2_Flag = true;    
      // Отмечаем истечение почти-секунды 
      if (quatr==4) 
      { 
         quatr = 0; OneSecondFlag = true; 
      }
   }
   /*
   // Если счетчик дошел до 1 мсек, то выполняем подстройки
   if (cntrMotion>timerMotion)
   {
      cntrMotion=0;
      OneMillSecFlag = true;
   }
   */
}

#endif

// ********************************************************* timer2_kru.ino ***
