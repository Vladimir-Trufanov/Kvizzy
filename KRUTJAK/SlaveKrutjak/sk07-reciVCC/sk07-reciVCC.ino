/** KRUTJAK-SLAVE-PRO_MINI                             *** sk07-reciVCC.ino ***
 * 
 * sk07 - Передать в управляющую систему напряжение батареи и потенциал 
 *        драйвера мотора
 * 
 * v3.2, 19.04.2024                                   Автор:      Труфанов В.Е.
 * Copyright © 2024 tve                               Дата создания: 12.04.2024
**/

#include <iarduino_VCC.h> 
#include <SoftwareSerial.h>

#include "define_slave_kru.h"  // подключили определения исполнительной системы 
#include "common_slave_kru.h"  // подключили общие функции исполнительной системы 
#include "timer_kru.h"         // подключили 1-ое таймерное прерывание 

void setup() 
{
   serialSlave.begin(300); 
   if (ModeSlave==modeDebug) Serial.begin(9600);
   // Инициируем секундное первое прерывание (с частотой в 1 Гц)
   IniTimer1();
}

/** Система команд ИК-пульта управления паровозиком
 * 
 * - 1 - "стоп паровоз"       	- TV-VCR
 * - 2 - "включить SLAVE" 		- ON standby
 * - 3 - "начать движение"    	- A.REP 
 * -20 - "начать движение"    	- REC 
 * -21 - "назад"              	- == 
 * -22 -                      	- >|<    
 * -24 - "медленнее"          	- <<  
 * -25 - "вперед"             	- =>
 * -26 - "быстрее"            	- >>   
 * -32 - "звук вкл/выкл"      	- EJECT
 * -33 -                      	- A.TRK
 * -44 - "подключить"         	- TRACKING ON 
 * -45 - "отключить"          	- TRACKING OFF 
 * -50 - "тестировать систему"	- SYSTEM
 * 
**/

void loop() 
{
   // Принимаем и собираем командную последовательность
   // от управляющей системы в строку (String) без "обрывов"
   while(serialSlave.available())
   {
      simb=serialSlave.read();
      strData += (char)simb;   // добавили в строку принятый символ
      recievedFlag = true;     // устанавливаем флаг, что получили данные
      delay(40);               // ожидание завершения поступления символов !!!
   }
   // Разбираем команду и выполняем действие
   if (recievedFlag) 
   {                      
     if (ModeSlave==modeDebug) Serial.println(strData);  
      // Извлекаем код команды
      command=getCom(strData);
      // Отрабатываем команду по оборудованию исполняющей системы 
      reskom=actionCom(command);      
      // Чистим командную последовательность и сбрасываем флаг
      strData = "";                     
      recievedFlag = false;           
   }
   // Выполняем действия по прошествии 1 секунды
   if (OneSecondFlag==true)
   {
      if (ModeSlave==modeDebug) 
      {
         Serial.print("Vcc="); 
         Serial.println(analogRead_VCC()); 
      } 
      // Сбрасываем флаг одной секунды
      OneSecondFlag = false;
   }
}

// ****************************************************************************
// *           Извлечь код команды из командной последовательности            *
// ****************************************************************************
uint16_t getCom(String strData) 
{
   uint16_t command = 0;  
   return command; 
}

// ****************************************************************************
// *           Отработать команду по оборудованию исполняющей системы         *
// ****************************************************************************
int actionCom(uint16_t command) 
{
   int reskom=0;   // "действие выполнено успешно"
   return reskom;
}

// ******************************************************* sk07-reciVCC.ino ***
