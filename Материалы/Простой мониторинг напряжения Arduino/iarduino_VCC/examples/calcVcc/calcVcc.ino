// Данный пример улучшает точность рассчета Vcc:      // 
// Введите в монитор последовательного порта          //
// измеренное напряжение питания в Вольтах.           //
// (не менее 2 знаков после запятой)                  //
                                                      // 
#include <iarduino_VCC.h>                             // Подключаем библиотеку определения напряжения питания.
                                                      // 
void setup(){                                         // 
    Serial.begin(9600);                               // Инициируем передачу данных по шине UART на скорости 9600 бит/сек.
    while(!Serial){}                                  // Ждём завершения инициализации.
}                                                     // 
                                                      // 
void loop(){                                          // 
//  Если в монитор последовательного порта ввели Vcc: // 
    if(Serial.available()){                           // Если в буфере UART есть данные, то ...
    //  Получаем введённое напряжение Vcc в inVcc:    // 
        float inVcc=0, j=0;                           // 
        byte  i;                                      // 
        while(Serial.available()){                    // Проходим по всем полученным байтам буфера UART ...
            i = Serial.read();                        // Читаем очередной байт в переменную i.
            if((i=='.')||(i==',')){j=1;}else          // Если прочитанный байт является символом точки, начинаем считать количество символов после запятой.
            if(((i-'0')>=0)&&((i-'0')<=9)){           // Если прочитанный байт является символом цифры.
                inVcc*=10.0f; inVcc+=(float)(i-'0');  // Добавляем цифру i к числу inVcc.
//              inVcc=inVcc*10.0f+(float)(i-'0');     //
                if(j>0){j*=10;}                       // 
            }   delay(2);                             // 
        }   inVcc/=j==0.0?1:j;                        // 
    //  Выводим полученное значение inVcc:            // 
        Serial.print("Введено значение Vcc = ");      // 
        Serial.print(inVcc, 3);                       // 
    //  Рассчитываем реальное значение ИОН 1V1:       // ИОН - внутренний источник опорного напряжения.
        j = analogCalc_1V1(inVcc);                    //
    //  Выводим рассчитанное значение ИОН 1V1:        // 
        Serial.print("В, значит ИОН 1V1 = ");         // 
        Serial.print(j, 3);                           // Значение ИОН 1V1 которое Вы увидите в мониторе, является константой для данной платы Arduino.
        Serial.print("В.\r\n");                       // 
    //  Применяем новое значение ИОН 1V1:             // 
        analogSave_1V1(j);                            // Зная значение j, эту функцию можно однократно указывать в коде setup(). См пример «readVcc».
    }                                                 // 
                                                      // 
//  Выводим напряжение питания Arduino:               // 
    Serial.print( "Vcc = "         );                 // 
    Serial.print( analogRead_VCC() );                 // Выводим напряжение питания.
    Serial.print( " V.\r\n"        );                 // 
    delay(100);                                       // 
}                                                     // 
